#include "../Inc/bldcFOC_core.h"

/* Q15 half-sine table — sin_q15_half[i] = round(sin(i*pi/180)*32767), i in 0..179.
 * Generated by generate_sine_table.py (truncated to first 180 entries);
 * sin_q15 negates the second half to reconstruct 180..359. */
const int16_t sine_q15_half[180] = {
         0,    572,   1144,   1715,   2286,   2856,   3425,   3993,   4560,   5126,
      5690,   6252,   6813,   7371,   7927,   8481,   9032,   9580,  10126,  10668,
     11207,  11743,  12275,  12803,  13328,  13848,  14364,  14876,  15383,  15886,
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      5690,   5126,   4560,   3993,   3425,   2856,   2286,   1715,   1144,    572
};

/* ============ Transforms ============ */

ab_i_t clarke(iph_t i) {
    /* Iα = Iy
     * Iβ = (Iy + 2·Ib) / √3   (uses Ia + Ib + Ic = 0 to eliminate Ic) */
    ab_i_t out;
    int32_t beta_num = (int32_t)i.iy + 2 * (int32_t)i.ib;
    out.alpha = i.iy;
    out.beta  = (int16_t)((beta_num * Q15_INV_SQRT3) >> 15);
    return out;
}

/* Forward Park: R(-θ) convention — Krause / Leonhard family.
 *   d = α·cos(θ) + β·sin(θ)
 *   q = -α·sin(θ) + β·cos(θ) */
dq_i_t park(ab_i_t i, int16_t theta_deg) {
    int16_t c = cos_q15(theta_deg);
    int16_t s = sin_q15(theta_deg);
    dq_i_t out;
    out.d = (int16_t)(((int32_t)i.alpha * c + (int32_t)i.beta  * s) >> 15);
    out.q = (int16_t)(((int32_t)(-i.alpha) * s + (int32_t)i.beta * c) >> 15);
    return out;
}

/* Inverse Park: R(+θ), transpose of park().
 *   α = d·cos(θ) - q·sin(θ)
 *   β = d·sin(θ) + q·cos(θ) */
ab_v_t ipark(dq_v_t v, int16_t theta_deg) {
    int16_t c = cos_q15(theta_deg);
    int16_t s = sin_q15(theta_deg);
    ab_v_t out;
    out.alpha = (int16_t)(((int32_t)v.d * c - (int32_t)v.q * s) >> 15);
    out.beta  = (int16_t)(((int32_t)v.d * s + (int32_t)v.q * c) >> 15);
    return out;
}

/* Inverse Clarke (α = yellow) + SVPWM min-max injection.
 * Pre-centering phase values use Q15 constants for ½ and √3/2.
 * Post-centering subtracts (max+min)/2 from each phase — standard SVPWM. */
void iclarke_svpwm(ab_pwm_t v, int16_t *y, int16_t *b, int16_t *g) {
    int32_t alpha = v.alpha;
    int32_t beta  = v.beta;
    int32_t vy = alpha;
    int32_t vb = (-alpha * Q15_HALF + beta * Q15_SQRT3_OVER_2) >> 15;
    int32_t vg = (-alpha * Q15_HALF - beta * Q15_SQRT3_OVER_2) >> 15;

    int32_t vmax = vy;
    if (vb > vmax) vmax = vb;
    if (vg > vmax) vmax = vg;
    int32_t vmin = vy;
    if (vb < vmin) vmin = vb;
    if (vg < vmin) vmin = vg;
    int32_t centre = (vmax + vmin) >> 1;   /* ASR preserves sign */

    *y = (int16_t)(vy - centre);
    *b = (int16_t)(vb - centre);
    *g = (int16_t)(vg - centre);
}

/* Dead-time compensation — adds sign(i)-proportional correction to each
 * PWM delta; derives ig from iy + ib. Soft-limited by dtc_term. */
void dtc_apply(iph_t i, int16_t *y, int16_t *b, int16_t *g) {
    int16_t ig = (int16_t)(-(i.iy + i.ib));
    *y = (int16_t)(*y + dtc_term(i.iy));
    *b = (int16_t)(*b + dtc_term(i.ib));
    *g = (int16_t)(*g + dtc_term(ig));
}

/* ============ Block commutation (BC) — 6-step table ============
 * Verbatim match of bldcBC.c; kept pure so the FOC TU can call it for
 * BC-mode dispatch and pos_force without depending on bldcBC.c. */
void get_pwm_bc(int pwm, int pos, int16_t *y, int16_t *b, int16_t *g) {
    int16_t p = (int16_t)pwm;
    switch (pos) {
    case 1: *y = 0;              *b = p;              *g = (int16_t)-p;     break;
    case 2: *y = (int16_t)-p;    *b = p;              *g = 0;                break;
    case 3: *y = (int16_t)-p;    *b = 0;              *g = p;                break;
    case 4: *y = 0;              *b = (int16_t)-p;    *g = p;                break;
    case 5: *y = p;              *b = (int16_t)-p;    *g = 0;                break;
    case 6: *y = p;              *b = 0;              *g = (int16_t)-p;     break;
    default: *y = 0; *b = 0; *g = 0;
    }
}

/* ============ Hall PLL ============ */

static const int16_t sector_centre_deg[6] = { 180, 240, 300, 0, 60, 120 };

void pll_advance(pll_state_t *state) {
    if (state->sector_dwell < UINT16_MAX) state->sector_dwell++;
    state->angle_accum_q8 += state->velocity_q8;
    if (state->angle_accum_q8 >= (360 << 8)) state->angle_accum_q8 -= (360 << 8);
    else if (state->angle_accum_q8 < 0)      state->angle_accum_q8 += (360 << 8);
}

pll_edge_t pll_edge(pll_state_t *state, int8_t pos, const uint16_t *sector_width_q8) {
    pll_edge_t ret = { 0, -1, PLL_EDGE_SEED };

    /* First-call seed: no prior dwell to attribute. */
    if (state->prev_pos == 0) {
        state->angle_accum_q8 = (int32_t)sector_centre_deg[pos - 1] << 8;
        state->velocity_q8    = 0;
        state->prev_pos       = pos;
        state->sector_dwell   = 0;
        ret.kind = PLL_EDGE_SEED;
        return ret;
    }

    int8_t delta = (int8_t)(pos - state->prev_pos);
    int8_t dir;
    if      (delta ==  1 || delta == -5) dir = +1;
    else if (delta == -1 || delta ==  5) dir = -1;
    else {
        ret.kind = PLL_EDGE_GLITCH;
        return ret;
    }

    uint16_t consumed   = state->sector_dwell;
    int8_t   sector_idx = (int8_t)(state->prev_pos - 1);

    if (state->sector_dwell > 0) {
        int32_t v = ((int32_t)dir * (int32_t)sector_width_q8[sector_idx])
                    / (int32_t)state->sector_dwell;
        if (v >  FOC_PLL_VEL_CLAMP) v =  FOC_PLL_VEL_CLAMP;
        if (v < -FOC_PLL_VEL_CLAMP) v = -FOC_PLL_VEL_CLAMP;
        state->velocity_q8 = (int16_t)v;
    }

    /* Direction-aware snap: forward → lower boundary; reverse → upper. */
    int32_t cumsum = 0;
    for (int i = 0; i < pos - 1; i++) cumsum += sector_width_q8[i];
    int32_t snap = FOC_PLL_ANCHOR_Q8 + cumsum;
    if (dir < 0) snap += sector_width_q8[pos - 1];
    if (snap >= (360 << 8)) snap -= (360 << 8);
    state->angle_accum_q8 = snap;

    state->prev_pos     = pos;
    state->sector_dwell = 0;

    ret.kind            = PLL_EDGE_VALID;
    ret.consumed_dwell  = consumed;
    ret.consumed_sector = sector_idx;
    return ret;
}

/* ============ Hall width learner ============
 * Normalise per-sector ISR counts to a width table summing to ~(360<<8),
 * then fold the result into the live table via an EMA. */
void hall_widths_update(uint16_t widths[6],
                        const uint32_t learn_sum[6],
                        uint8_t ema_shift) {
    uint32_t total = 0;
    for (int i = 0; i < 6; i++) total += learn_sum[i];
    if (total == 0) return;
    for (int i = 0; i < 6; i++) {
        uint16_t measured = (uint16_t)(((uint64_t)(360u << 8) * learn_sum[i]) / total);
        int16_t  delta    = (int16_t)(measured - widths[i]);
        widths[i] = (uint16_t)((int32_t)widths[i] + (delta >> ema_shift));
    }
}
